## esp32c6_firmware/main/Kconfig.projbuild
```kconfig
menu "LEDBrain C6 Coprocessor Configuration"

    config ESP_WIFI_SSID
        string "WiFi SSID"
        default "myssid"
        help
            SSID (network name) for the WiFi network to connect to.

    config ESP_WIFI_PASSWORD
        string "WiFi Password"
        default "mypassword"
        help
            WiFi password (WPA or WPA2) for the network.

    config ESP_MAXIMUM_RETRY
        int "Maximum WiFi Connection Retries"
        default 5
        help
            Maximum number of retries when connecting to WiFi AP.

    config EXAMPLE_UART_TX_PIN
        int "UART TX Pin (ESP32-C6 to ESP32-P4)"
        default 18
        range 0 30
        help
            GPIO pin number for UART TX (ESP32-C6 TX -> ESP32-P4 RX).
            Default: 18 (can be adjusted based on board schematic)

    config EXAMPLE_UART_RX_PIN
        int "UART RX Pin (ESP32-P4 to ESP32-C6)"
        default 17
        range 0 30
        help
            GPIO pin number for UART RX (ESP32-P4 TX -> ESP32-C6 RX).
            Default: 17 (can be adjusted based on board schematic)

    config EXAMPLE_UART_BAUDRATE
        int "UART Baudrate"
        default 921600
        range 115200 3000000
        help
            Baudrate for PPP communication over UART.
            Higher baudrate = better performance (up to 3Mbps tested).

endmenu
```

## esp32c6_firmware/sdkconfig.defaults
```kconfig
# ESP32-C6 WiFi Coprocessor Firmware Default Configuration
# Target: ESP32-C6
# Purpose: WiFi gateway for ESP32-P4 via PPP over UART

# Target configuration
CONFIG_IDF_TARGET="esp32c6"

# WiFi
CONFIG_ESP_WIFI_ENABLED=y
CONFIG_ESP_WIFI_STATIC_RX_BUFFER_NUM=10
CONFIG_ESP_WIFI_DYNAMIC_RX_BUFFER_NUM=32
CONFIG_ESP_WIFI_TX_BUFFER_TYPE=1
CONFIG_ESP_WIFI_DYNAMIC_TX_BUFFER_NUM=32
CONFIG_ESP_WIFI_AMPDU_TX_ENABLED=y
CONFIG_ESP_WIFI_AMPDU_RX_ENABLED=y
CONFIG_ESP_WIFI_AMSDU_TX_ENABLED=y
CONFIG_ESP_WIFI_NVS_ENABLED=y

# PPP over UART
CONFIG_EPPP_LINK_USES_PPP=y
CONFIG_EPPP_LINK_DEVICE_UART=y
CONFIG_LWIP_PPP_SUPPORT=y
CONFIG_LWIP_PPP_PAP_SUPPORT=y
CONFIG_LWIP_PPP_CHAP_SUPPORT=y
CONFIG_LWIP_PPP_MSCHAP_SUPPORT=y
CONFIG_LWIP_PPP_MPPE_SUPPORT=y

# NAPT (Network Address Port Translation) for Internet sharing
CONFIG_LWIP_IP_FORWARD=y
CONFIG_LWIP_IPV4_NAPT=y
CONFIG_LWIP_TCPIP_TASK_STACK_SIZE=4096

# Logging
CONFIG_LOG_DEFAULT_LEVEL_INFO=y
CONFIG_LOG_DEFAULT_LEVEL=3

# Partition table
CONFIG_PARTITION_TABLE_SINGLE_APP=y

# Bootloader
CONFIG_BOOTLOADER_LOG_LEVEL_INFO=y

# NVS
CONFIG_NVS_ENCRYPTION=n
```

## sdkconfig.defaults.txt
```kconfig
# SPI speed/flash
CONFIG_ESPTOOLPY_FLASHMODE_DIO=y
CONFIG_ESPTOOLPY_FLASHFREQ_80M=y
CONFIG_ESPTOOLPY_FLASHSIZE_4MB=y
CONFIG_ESPTOOLPY_FLASHSIZE="4MB"
# Partition table configuration
CONFIG_PARTITION_TABLE_CUSTOM=y
CONFIG_PARTITION_TABLE_CUSTOM_FILENAME="partitions.csv"
CONFIG_PARTITION_TABLE_FILENAME="partitions.csv"
CONFIG_PARTITION_TABLE_OFFSET=0x8000
# Disable single app partition table (use custom instead)
# CONFIG_PARTITION_TABLE_SINGLE_APP is not set
# Note: SD card (64GB) support will be added for data storage
CONFIG_BOOTLOADER_APP_ROLLBACK_ENABLE=n
CONFIG_BOOTLOADER_LOG_LEVEL_INFO=y
CONFIG_BOOTLOADER_LOG_LEVEL=3
CONFIG_BOOTLOADER_WDT_ENABLE=y
CONFIG_BOOTLOADER_WDT_TIME_MS=9000

# SPIFS (for critical config, firmware, small files < 1MB)
CONFIG_SPIFFS_MAX_PARTITIONS=1
CONFIG_SPIFFS_USE_MAGIC=y
CONFIG_SPIFFS_USE_MAGIC_LENGTH=y
CONFIG_SPIFFS_USE_MTIME=y

# FATFS (for SD card - supports FAT32, FAT16, FAT12, exFAT)
# Note: exFAT support is available in ESP-IDF v5.1+
CONFIG_FATFS_LONG_FILENAMES=y
CONFIG_FATFS_LONG_FILENAME_HEAP=y
CONFIG_FATFS_MAX_LFN=255
CONFIG_FATFS_API_ENCODING_UTF_8=y
CONFIG_FATFS_FS_LOCK=0
CONFIG_FATFS_TIMEOUT_MS=10000
CONFIG_FATFS_PER_FILE_CACHE=y
# exFAT support (for SD cards > 32GB)
CONFIG_FATFS_FS_FAT12=n
CONFIG_FATFS_FS_FAT16=n
CONFIG_FATFS_FS_FAT32=y
CONFIG_FATFS_FS_EXFAT=y
CONFIG_FATFS_EXFAT_MAX_NAME_LEN=255
CONFIG_FATFS_EXFAT_USE_MEMORY_FUNCS=y

# HTTP server
CONFIG_ESP_HTTP_SERVER_ENABLE=true
CONFIG_ESP_HTTP_CLIENT_ENABLE_HTTPS=y
CONFIG_MBEDTLS_CERTIFICATE_BUNDLE=y
CONFIG_ESP_HTTPS_OTA=y

# mDNS
CONFIG_LWIP_LOCAL_HOSTNAME="ledbrain"
CONFIG_MDNS_NETWORKING_LWIP=y
CONFIG_MDNS_ENABLE_CONSOLE_CLI=n
CONFIG_MDNS_PREDEF_NETIF_ETH=y
CONFIG_MDNS_PREDEF_NETIF_STA=n
CONFIG_MDNS_PREDEF_NETIF_AP=n

# Ethernet
CONFIG_ETH_USE_ESP32_EMAC=y
CONFIG_ETH_RMII_CLOCK_OUTPUT=y
CONFIG_ETH_RMII_CLK_OUTPUT=y
CONFIG_ETH_ENABLED=y

# WiFi via ESP32-C6 coprocessor (PPP over UART)
# ESP32-P4 connects to ESP32-C6 via eppp_link for WiFi connectivity
CONFIG_EPPP_LINK_USES_PPP=y
CONFIG_EPPP_LINK_DEVICE_UART=y
CONFIG_LWIP_PPP_SUPPORT=y
CONFIG_LWIP_PPP_PAP_SUPPORT=y
CONFIG_LWIP_PPP_CHAP_SUPPORT=y
CONFIG_LWIP_PPP_MSCHAP_SUPPORT=y
CONFIG_LWIP_PPP_MPPE_SUPPORT=y
CONFIG_LWIP_PPP_IPV6_SUPPORT=y

# MQTT
CONFIG_MQTT_PROTOCOL_311=y
```
